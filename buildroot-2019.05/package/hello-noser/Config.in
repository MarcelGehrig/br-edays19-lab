## buildroot-2019.05/package/hello-noser/Config.in
```kconfig
config BR2_PACKAGE_HELLO_NOSER
    bool "hello_noser"
    help
        Hello Noser package.

        http://www.noser.com
```

## noser-external/Config.in
```kconfig
source "$BR2_EXTERNAL_NOSER_PATH/package/hello-noser/Config.in"
source "$BR2_EXTERNAL_NOSER_PATH/package/hello-noser2/Config.in"
```

## noser-external/configs/noser_defconfig
```kconfig
BR2_arm=y
BR2_PACKAGE_HOST_LINUX_HEADERS_CUSTOM_4_19=y
BR2_TARGET_GENERIC_ROOT_PASSWD="noser"
BR2_TARGET_GENERIC_GETTY_PORT="ttyAMA0"
BR2_SYSTEM_DHCP="eth0"
BR2_LINUX_KERNEL=y
BR2_LINUX_KERNEL_CUSTOM_VERSION=y
BR2_LINUX_KERNEL_CUSTOM_VERSION_VALUE="4.19.16"
BR2_LINUX_KERNEL_USE_CUSTOM_CONFIG=y
BR2_LINUX_KERNEL_CUSTOM_CONFIG_FILE="board/qemu/arm-versatile/linux.config"
BR2_LINUX_KERNEL_DTS_SUPPORT=y
BR2_LINUX_KERNEL_INTREE_DTS_NAME="versatile-pb"
BR2_PACKAGE_BUSYBOX_SHOW_OTHERS=y
BR2_PACKAGE_TFTPD=y
BR2_PACKAGE_LIBCURL=y
BR2_PACKAGE_DROPBEAR=y
BR2_TARGET_ROOTFS_EXT2=y
BR2_TARGET_ROOTFS_EXT2_4=y
BR2_TARGET_ROOTFS_TAR_GZIP=y
BR2_PACKAGE_HELLO_NOSER=y
BR2_PACKAGE_HELLO_NOSER2=y
```

## noser-external/package/hello-noser2/Config.in
```kconfig
config BR2_PACKAGE_HELLO_NOSER2
    bool "hello_noser2"
    help
        Hello Noser2 package.

        http://www.noser.com
```
